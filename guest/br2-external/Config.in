## guest/br2-external/configs/hart_defconfig
```kconfig
# hart guest: RV64GC, internal musl toolchain, OpenSBI generic, Linux 6.18 LTS,
# BusyBox initramfs. Pinned by Buildroot 2026.08.1.
BR2_riscv=y
BR2_riscv_g=y
BR2_RISCV_ISA_RVC=y
BR2_RISCV_64=y
BR2_RISCV_ABI_LP64D=y
BR2_DOWNLOAD_FORCE_CHECK_HASHES=y
BR2_GLOBAL_PATCH_DIR="$(BR2_EXTERNAL_HART_PATH)/board/hart/hashes"
BR2_REPRODUCIBLE=y
BR2_TOOLCHAIN_BUILDROOT_MUSL=y
BR2_KERNEL_HEADERS_AS_KERNEL=y
BR2_PACKAGE_HOST_LINUX_HEADERS_CUSTOM_6_18=y
BR2_TARGET_GENERIC_HOSTNAME="hart"
BR2_TARGET_GENERIC_ISSUE="Welcome to hart!"
# BR2_TARGET_GENERIC_GETTY is not set
BR2_SYSTEM_DHCP=""
BR2_ROOTFS_OVERLAY="$(BR2_EXTERNAL_HART_PATH)/board/hart/rootfs-overlay"
BR2_ROOTFS_POST_BUILD_SCRIPT="$(BR2_EXTERNAL_HART_PATH)/board/hart/post-build.sh"
BR2_LINUX_KERNEL=y
BR2_LINUX_KERNEL_CUSTOM_VERSION=y
BR2_LINUX_KERNEL_CUSTOM_VERSION_VALUE="6.18.55"
BR2_LINUX_KERNEL_USE_ARCH_DEFAULT_CONFIG=y
BR2_LINUX_KERNEL_CONFIG_FRAGMENT_FILES="$(BR2_EXTERNAL_HART_PATH)/board/hart/linux.fragment"
BR2_PACKAGE_BUSYBOX_CONFIG_FRAGMENT_FILES="$(BR2_EXTERNAL_HART_PATH)/board/hart/busybox.fragment"
# BR2_PACKAGE_IFUPDOWN_SCRIPTS is not set
BR2_PACKAGE_HART_DEMOS=y
BR2_TARGET_ROOTFS_CPIO=y
BR2_TARGET_ROOTFS_INITRAMFS=y
# BR2_TARGET_ROOTFS_TAR is not set
BR2_TARGET_OPENSBI=y
BR2_TARGET_OPENSBI_LATEST_VERSION=y
BR2_TARGET_OPENSBI_PLAT="generic"
BR2_TARGET_OPENSBI_INSTALL_DYNAMIC_IMG=y
BR2_TARGET_OPENSBI_INSTALL_JUMP_IMG=y
BR2_TARGET_OPENSBI_ADDITIONAL_VARIABLES="FW_JUMP_FDT_ADDR=0x88000000"
```

## guest/br2-external/package/hart-demos/Config.in
```kconfig
config BR2_PACKAGE_HART_DEMOS
	bool "hart-demos"
	help
	  Demo programs for the hart guest: an ASCII Mandelbrot renderer
	  computed in double precision (/usr/bin/mandelbrot).
```
